## board/A.R.f./p_a5_tab_reva/Kconfig
```kconfig
if TARGET_P_A5_TAB_REVA

config SYS_BOARD
	default "p_a5_tab_reva"

config SYS_VENDOR
	default "A.R.f."

config SYS_SOC
	default "at91"

config SYS_CONFIG_NAME
	default "p_a5_tab_reva"

endif
```

## configs/p_a5_tab_reva_defconfig
```kconfig
CONFIG_ARM=y
CONFIG_ARCH_AT91=y
CONFIG_SYS_TEXT_BASE=0x26f00000
CONFIG_TARGET_P_A5_TAB_REVA=y
CONFIG_SYS_EXTRA_OPTIONS="SAMA5D2,SYS_USE_MMC"
# CONFIG_CMD_IMI is not set
# CONFIG_CMD_IMLS is not set
# CONFIG_CMD_LOADS is not set
# CONFIG_CMD_FLASH is not set
CONFIG_CMD_MMC=y
# CONFIG_CMD_FPGA is not set
# CONFIG_CMD_NET is not set
# CONFIG_CMD_NFS is not set
# CONFIG_CMD_CPU is not set
CONFIG_CMD_CONFIG=y
CONFIG_CMD_MEMINFO=y
CONFIG_BOARD_EARLY_INIT_F=y
CONFIG_DM=y
CONFIG_DM_SERIAL=y
CONFIG_DEBUG_UART=y
CONFIG_DEBUG_UART_ATMEL=y
CONFIG_DEBUG_UART_BASE=0xf8038200
CONFIG_DEBUG_UART_CLOCK=58000000
CONFIG_DEBUG_UART_BOARD_INIT=y
CONFIG_DEBUG_UART_ANNOUNCE=y
CONFIG_ATMEL_USART=y
CONFIG_OF_CONTROL=y
CONFIG_DM_GPIO=y
CONFIG_ATMEL_PIO4=y
CONFIG_DEFAULT_DEVICE_TREE="p_a5_tab_reva"
# Extra
# CONFIG_CMD_CONSOLE=y 

CONFIG_SERIAL_PRESENT=y
#CONFIG_DEBUG_UART_SKIP_INIT=y

# CONFIG_SUPPORT_EMMC_BOOT=y

#CONFIG_SKIP_LOWLEVEL_INIT=y

# CONFIG_FLASH_SHOW_PROGRESS=45
CONFIG_PINCTRL_AT91PIO4=y
CONFIG_PINCTRL=y
# CONFIG_SYS_EXTRA_OPTIONS="SAMA5D2,SYS_USE_MMC"

CONFIG_BOOTDELAY=0
CONFIG_CMD_CONSOLE=y 

#CONFIG_OF_SEPARATE=y

CONFIG_DM_MMC=y
CONFIG_MMC_SDHCI=y
CONFIG_MMC_SDHCI_ATMEL=y
CONFIG_SPL=n
CONFIG_SPL_SPI_LOAD=y
CONFIG_SPL_GPIO_SUPPORT=y
CONFIG_SPL_MMC_SUPPORT=y
CONFIG_SPL_FRAMEWORK=y
CONFIG_DM_SPI=y
CONFIG_ATMEL_QSPI=y
CONFIG_ATMEL_SPI=y
CONFIG_SYS_MALLOC_F_LEN=0x2000

CONFIG_AT91_GENERIC_CLK=y
CONFIG_CLK=y
CONFIG_CLK_AT91=y
CONFIG_SPL_CLK=y
# CONFIG_BOARD_EARLY_INIT_R is not set
CONFIG_BOARD_POSTCLK_INIT=y
CONFIG_BOARD_LATE_INIT_F=y
CONFIG_BOARD_POSTCLK_INIT=y
CONFIG_AT91_UTMI=y
CONFIG_AT91_H32MX=y
CONFIG_CMD_BOOTI=y
CONFIG_CMD_BOOTZ=y
CONFIG_CMD_FAT=y
CONFIG_CMD_EXT4=y
#CONFIG_CMD_USB=y
CONFIG_SD_BOOT=y
CONFIG_CMD_EXT2=y

CONFIG_SPL_LIBCOMMON_SUPPORT=y
CONFIG_SPL_LIBGENERIC_SUPPORT=y
CONFIG_SPL_SERIAL_SUPPORT=y
CONFIG_SPL_DRIVERS_MISC_SUPPORT=y
CONFIG_SPL_LIBDISK_SUPPORT=y
# CONFIG_DISPLAY_BOARDINFO is not set
CONFIG_SPL_SEPARATE_BSS=y
CONFIG_SPL_OF_CONTROL=y
CONFIG_OF_SPL_REMOVE_PROPS="interrupts interrupt-parent dmas dma-names"
CONFIG_SPL_DM=y
CONFIG_SPL_DM_SEQ_ALIAS=y
CONFIG_SPL_PINCTRL=y
CONFIG_SPL_TIMER=y
```
